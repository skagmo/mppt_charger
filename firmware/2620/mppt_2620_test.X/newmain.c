#include <stdio.h>
#include <stdlib.h>
#include <stdint.h>
#include <p18f2620.h>
#include "platform.h"

#define CHAR_WIDTH			5
#define CHAR_BIG_WIDTH		7
#define LCD_WIDTH			128
#define LCD_X_OFFSET		0
#define LCD_LINES			8
#define CMD_DISPLAY_ON		0xAF
#define CMD_DISP_START_LINE 0x40
#define CMD_PAGE			0xB0
#define CMD_COLUMN_UPPER	0x10
#define CMD_COLUMN_LOWER	0x00
#define CMD_ADC_NORMAL		0xA0
#define CMD_ADC_REV			0xA1
#define CMD_ALLPTS_NORMAL	0xA4
#define CMD_BIAS_7			0xA3
#define CMD_RMW				0xE0
#define CMD_SHL_NORMAL		0xC0
#define CMD_SHL_FLIP		0xC8
#define CMD_POWER_CONTROL	0x28
#define CMD_RESISTOR_RATIO  0x20
#define CMD_VOLUME_FIRST	0x81
#define CMD_VOLUME_SECOND	0x00

uint8_t lcd_x;
uint8_t lcd_line;
uint8_t lcd_buf[1024];

// Skagmo Electronics logo converted with the dot factory. Bit layout: ColumnMajor, lsbfirst.
const uint8_t se_logo[] = {
	0x00, 0xC0, 0xF0, 0x78, 0x1C, 0x0C, 0x0E, 0x06, 0x06, 0x07, 0x03, 0x03,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 0x00,
	0xFF, 0xFF, 0x01, 0x00, 0x00, 0x00, 0x00, 0x00, 0x00, 0x00, 0x00, 0x00,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 0xFE,
	0xFF, 0xFF, 0x00, 0x00, 0x00, 0x00, 0x80, 0xC0, 0xE0, 0x70, 0x38, 0x1C,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 0x07,
	0xFF, 0x7F, 0x38, 0x1C, 0x0E, 0x07, 0x03, 0x01, 0x00, 0x80, 0xC0, 0xE0,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 0x80,
	0x00, 0x80, 0xC0, 0xE0, 0xF0, 0xB8, 0x9C, 0x8E, 0x87, 0x83, 0x81, 0x80,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 0x79,
	0x01, 0x01, 0x01, 0x01, 0x01, 0x01, 0x01, 0x01, 0x01, 0x01, 0x01, 0x01,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 0x00,
};

const uint8_t lcd_font[][5] = {
	{0x00,0x00,0x00,0x00,0x00},   //   0x20 32
	{0x00,0x00,0x6f,0x00,0x00},   // ! 0x21 33
	{0x00,0x07,0x00,0x07,0x00},   // " 0x22 34
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	{0x7f,0x6b,0x6b,0x6b,0x7f},   //  0x7f 127
};

// Big number font from arduino GLCD library
const uint8_t lcd_font_big[] = {
// char '+'
0x00, 0x80, 0x80, 0xe0, 0xe0, 0x80, 0x80,
0x00, 0x00, 0x00, 0x03, 0x03, 0x00, 0x00,

// char ','
0x00, 0x00, 0x00, 0x00, 0x00, 0x00, 0x00,
0x00, 0x00, 0x00, 0x58, 0x38, 0x00, 0x00,

// char '-'
0x80, 0x80, 0x80, 0x80, 0x80, 0x80, 0x80,
0x00, 0x00, 0x00, 0x00, 0x00, 0x00, 0x00,

// char '.'
0x00, 0x00, 0x00, 0x00, 0x00, 0x00, 0x00,
0x00, 0x00, 0x00, 0x30, 0x30, 0x00, 0x00,

// char '/'
0x00, 0x00, 0x00, 0xc0, 0xf0, 0x3c, 0x0f,
0x00, 0x3c, 0x0f, 0x03, 0x00, 0x00, 0x00,

// char '0'
0xfc, 0xfe, 0x03, 0xe1, 0x1b, 0xfe, 0xfc,
0x0f, 0x1f, 0x36, 0x21, 0x30, 0x1f, 0x0f,

// char '1'
0x04, 0x04, 0x06, 0xff, 0xff, 0x00, 0x00,
0x20, 0x20, 0x20, 0x3f, 0x3f, 0x20, 0x20,

// char '2'
0x0c, 0x0e, 0x03, 0x01, 0x81, 0xfe, 0x7c,
0x38, 0x3c, 0x26, 0x23, 0x21, 0x20, 0x20,

// char '3'
0x0c, 0x0e, 0x43, 0x41, 0x43, 0xfe, 0xbc,
0x0c, 0x1c, 0x30, 0x20, 0x30, 0x1f, 0x0f,

// char '4'
0x00, 0xe0, 0xfc, 0x1f, 0x83, 0x80, 0x00,
0x0f, 0x0f, 0x08, 0x08, 0x3f, 0x3f, 0x08,

// char '5'
0x3f, 0x3f, 0x21, 0x21, 0x61, 0xe1, 0x81,
0x0c, 0x1c, 0x30, 0x20, 0x30, 0x3f, 0x0f,

// char '6'
0xe0, 0xf8, 0x5c, 0x46, 0xc3, 0xc1, 0x01,
0x0f, 0x1f, 0x30, 0x20, 0x30, 0x3f, 0x0f,

// char '7'
0x01, 0x01, 0x01, 0x81, 0xf1, 0x7f, 0x0f,
0x00, 0x00, 0x3c, 0x3f, 0x03, 0x00, 0x00,

// char '8'
0x1c, 0xbe, 0xe3, 0x41, 0xe3, 0xbe, 0x1c,
0x0f, 0x1f, 0x30, 0x20, 0x30, 0x1f, 0x0f,

// char '9'
0x3c, 0x7e, 0xc3, 0x81, 0x81, 0xfe, 0xfc,
0x20, 0x30, 0x38, 0x0c, 0x07, 0x03, 0x00,

// char ':'
0x00, 0x00, 0x00, 0x60, 0x60, 0x00, 0x00,
0x00, 0x00, 0x00, 0x30, 0x30, 0x00, 0x00,

};

void lcd_bitmap(uint8_t* gfx, uint8_t x_size, uint8_t line_size){
	uint8_t x, line;
	for (line=0; line<line_size; line++){
		for (x=0; x<x_size; x++){
			lcd_buf[x+lcd_x+((line+lcd_line)*LCD_WIDTH)] = gfx[x+(line*x_size)];
		}
	}
}

#include "string.h"
void lcd_clear(void){
	memset (lcd_buf, 0, (LCD_WIDTH*LCD_LINES));
}

void spi(char data){
    (void)SSPBUF;
    SSPBUF = data;
    while(PIR1bits.SSPIF == 0);
    PIR1bits.SSPIF = 0;
}

void lcd_put(uint8_t c){
	uint8_t j;
	if (lcd_x > (LCD_WIDTH-CHAR_WIDTH+1)){
		lcd_x = 0;
		lcd_line++;
	}
	for (j=0; j<5; j++){
		lcd_buf[lcd_x+(lcd_line*LCD_WIDTH)] = lcd_font[c-0x20][j];
		lcd_x++;
	}
	lcd_buf[lcd_x+(lcd_line*LCD_WIDTH)] = 0;
	lcd_x++;
}

void lcd_put_large(uint8_t c){
	uint8_t j;

	// Check boundaries
	if (lcd_x > (LCD_WIDTH-CHAR_BIG_WIDTH)){
		lcd_x = 0;
		lcd_line+=2;
	}
	if (lcd_line < 1) lcd_line = 1;
	else if (lcd_line > 7) lcd_line = 7;

	// Upper line
	for (j=0; j<CHAR_BIG_WIDTH; j++){
		lcd_buf[lcd_x+((lcd_line-1)*LCD_WIDTH)] = lcd_font_big[((c-0x2b)*CHAR_BIG_WIDTH*2)+j];
		lcd_x++;
	}
	lcd_buf[lcd_x+((lcd_line-1)*LCD_WIDTH)] = 0;
	lcd_x -= CHAR_BIG_WIDTH;

	// Lower line
	for (j=CHAR_BIG_WIDTH; j<(CHAR_BIG_WIDTH*2); j++){
		lcd_buf[lcd_x+(lcd_line*LCD_WIDTH)] = lcd_font_big[((c-0x2b)*CHAR_BIG_WIDTH*2)+j];
		lcd_x++;
	}
	lcd_buf[lcd_x+(lcd_line*LCD_WIDTH)] = 0;
	lcd_x++;
}

void lcd_puts_large(char* s){
	while (*s) lcd_put_large(*(s++));
}

void lcd_puts(char* s){
	while (*s) lcd_put(*(s++));
}

void lcd_cursor(uint8_t x, uint8_t line){
	lcd_x = x;
	lcd_line = line;
}

void delay_ms(uint16_t n){
	uint16_t j;
	for (j=0;j<n;j++) __delay_ms(1);
}

void lcd_init(void){
	LCD_CS = 0;
	LCD_RESET = 0;
	delay_ms(1);
	LCD_RESET = 1;
	delay_ms(1);
	LCD_DATA_SEL = 0;
	LCD_CS = 0;
	spi(CMD_BIAS_7);				// Bias 1/7
	spi(CMD_ADC_REV);				// X-direction flip
	spi(CMD_SHL_FLIP);				// Y-direction flip
	spi(CMD_ALLPTS_NORMAL);
	spi(CMD_DISP_START_LINE);		// Start line 0
	spi(CMD_POWER_CONTROL | 0x4);	// VC on
	delay_ms(50);
	spi(CMD_POWER_CONTROL | 0x6);	// VR on
	delay_ms(50);
	spi(CMD_POWER_CONTROL | 0x7);	// VF on
	delay_ms(50);
	spi(CMD_RESISTOR_RATIO | 3);	// Set operating voltage
    spi(CMD_VOLUME_FIRST);
    spi(CMD_VOLUME_SECOND | (33 & 0x3f));	// Set contrast to 28 for Zolen, 33 for other
	spi(CMD_DISPLAY_ON);				// Enable display
	LCD_CS = 1;
}



void lcd_refresh(){
	uint8_t x, y;
	for (y=0; y<8; y++){
		LCD_DATA_SEL = 0;
		LCD_CS = 0;
		spi(CMD_PAGE | y);
		spi(CMD_COLUMN_LOWER|LCD_X_OFFSET);
		spi(CMD_COLUMN_UPPER);
		spi(CMD_RMW);
		LCD_DATA_SEL = 1;
		for(x=0; x<LCD_WIDTH; x++) spi(lcd_buf[x+(y*LCD_WIDTH)]);
		LCD_CS = 1;
	}
}

int main(int argc, char** argv) {
	platform_init();
	
	// SPI config
	SSPCON1bits.SSPM = 0; // 0=osc/4, 1=osc/16, 2 = osc/64
	SSPSTATbits.CKE = 1;
	SSPCON1bits.SSPEN = 1;

	lcd_init();
	lcd_clear();
	lcd_bitmap(se_logo, 127, 6);
	lcd_cursor(0, 6);
	lcd_puts("MPPT charger");
	lcd_cursor(0, 7);
	lcd_puts("HW 0.2, SW 0.2");
	lcd_refresh();
	delay_ms(2000);

	// REaltime, stats
	#define LCD_MODE_MEASURE 0
	#define LCD_MODE_PLOT 1
	#define LCD_MODE_SETTINGS 2
	uint8_t lcd_mode = LCD_MODE_MEASURE;

	while(1){
		lcd_clear();
		// If timed out:
		// Return to LCD_MODE_INFO
		// Turn off backlight if set to auto
		//
		switch (lcd_mode){
			case LCD_MODE_MEASURE:
				lcd_cursor(20, 0); lcd_puts("- Measurement -");
				lcd_cursor(0, 1); lcd_puts("State"); lcd_cursor(64, 1); lcd_puts("CHG");
				lcd_cursor(0, 2); lcd_puts("PV"); lcd_cursor(64, 2); lcd_puts("18.51"); lcd_put('V');
				lcd_cursor(0, 3); lcd_puts("Battery"); lcd_cursor(64, 3); lcd_puts("12.54"); lcd_put('V');

				lcd_cursor(0, 4); lcd_puts("Charge");
				lcd_cursor(0, 5); lcd_puts(" 0.81A"); lcd_cursor(64, 5); lcd_puts_large("7.5"); lcd_put('W');
				
				lcd_cursor(0, 6); lcd_puts("Load");
				lcd_cursor(0, 7); lcd_puts(" 22.27A"); lcd_cursor(64, 7); lcd_puts_large("127.3"); lcd_put('W');
				break;
			case LCD_MODE_PLOT:
				// To bat.    124Wh
				// From bat.  1215Wh
				// Effici.    89.3%
				// plot vs time! Log 24 hours charge and load, interval depends
				break;
			case LCD_MODE_SETTINGS:
				lcd_puts("OUT_1 OFF");
				lcd_puts("OUT_2 OFF");
				lcd_puts("BACKLIGHT OFF"); // OFF/ON/AUTO
				lcd_puts("RESET_STATS");
				lcd_puts("PLOT_TYPE"); // CHG_W, LOAD_W
				lcd_puts("PLOT_TIME"); // 1-24 hours
		}
		lcd_refresh();
		delay_ms(500);
	}
  
	return (EXIT_SUCCESS);
}

